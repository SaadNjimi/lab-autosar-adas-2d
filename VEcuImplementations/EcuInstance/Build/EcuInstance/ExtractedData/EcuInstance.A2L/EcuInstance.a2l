ASAP2_VERSION 1 60
/begin PROJECT Unit4 ""
/begin MODULE EcuInstance ""
/begin COMPU_METHOD VOID "" RAT_FUNC "%12.6f" "" COEFFS 0 1 0 0 0 1 /end COMPU_METHOD
/begin COMPU_METHOD boolean "" TAB_VERB "%g" "" COMPU_TAB_REF boolean_COMPU_VTAB /end COMPU_METHOD
/begin COMPU_VTAB boolean_COMPU_VTAB "" TAB_VERB 2 /* Number of pairs */ 0 "FALSE" 1 "TRUE" /end COMPU_VTAB
/begin COMPU_METHOD NO_COMPU_METHOD_2 "Automatically generated by dSPACE ASAP2 Import" RAT_FUNC "%6.3f" "" COEFFS 0 1 0 0 0 1 /end COMPU_METHOD
/begin COMPU_METHOD __Identity "" RAT_FUNC "%g" "" COEFFS 0 1 0 0 0 1 /end COMPU_METHOD
/begin COMPU_METHOD EcuM_CurrentStateScaling "" TAB_VERB "%g" "" COMPU_TAB_REF EcuM_CurrentStateScaling_COMPU_VTAB /end COMPU_METHOD
/begin COMPU_VTAB_RANGE EcuM_CurrentStateScaling_COMPU_VTAB "" 21 16 16 "STARTUP" 17 17 "STARTUP_ONE" 18 18 "STARTUP_TWO" 32 32 "WAKEUP" 33 33 "WAKEUP_ONE" 34 34 "WAKEUP_VALIDATION" 35 35 "WAKEUP_REACTION" 36 36 "WAKEUP_TWO" 37 37 "WAKEUP_WAKESLEEP" 38 38 "WAKEUP_TTII" 48 48 "RUN" 50 50 "APP_RUN" 51 51 "APP_POST_RUN" 64 64 "SHUTDOWN" 68 68 "PREP_SHUTDOWN" 73 73 "GO_SLEEP" 77 77 "GO_OFF_ONE" 78 78 "GO_OFF_TWO" 80 80 "SLEEP" 128 128 "OFF" 144 144 "RESET" DEFAULT_VALUE "INVALID_STATE" /end COMPU_VTAB_RANGE
/begin COMPU_METHOD EcuM_NextModeScaling "" TAB_VERB "%g" "" COMPU_TAB_REF EcuM_NextModeScaling_COMPU_VTAB /end COMPU_METHOD
/begin COMPU_VTAB_RANGE EcuM_NextModeScaling_COMPU_VTAB "" 6 0 0 "POST_RUN" 1 1 "RUN" 2 2 "SHUTDOWN" 3 3 "SLEEP" 4 4 "STARTUP" 5 5 "WAKE_SLEEP" DEFAULT_VALUE "STARTUP" /end COMPU_VTAB_RANGE
/begin RECORD_LAYOUT UBYTE__BASE_TYPE_RL FNC_VALUES 1 UBYTE COLUMN_DIR DIRECT /end RECORD_LAYOUT
/begin RECORD_LAYOUT SBYTE__BASE_TYPE_RL FNC_VALUES 1 SBYTE COLUMN_DIR DIRECT /end RECORD_LAYOUT
/begin RECORD_LAYOUT UWORD__BASE_TYPE_RL FNC_VALUES 1 UWORD COLUMN_DIR DIRECT /end RECORD_LAYOUT
/begin RECORD_LAYOUT SWORD__BASE_TYPE_RL FNC_VALUES 1 SWORD COLUMN_DIR DIRECT /end RECORD_LAYOUT
/begin RECORD_LAYOUT ULONG__BASE_TYPE_RL FNC_VALUES 1 ULONG COLUMN_DIR DIRECT /end RECORD_LAYOUT
/begin RECORD_LAYOUT SLONG__BASE_TYPE_RL FNC_VALUES 1 SLONG COLUMN_DIR DIRECT /end RECORD_LAYOUT
/begin RECORD_LAYOUT FLOAT32_IEEE__BASE_TYPE_RL FNC_VALUES 1 FLOAT32_IEEE COLUMN_DIR DIRECT /end RECORD_LAYOUT
/begin RECORD_LAYOUT FLOAT64_IEEE__BASE_TYPE_RL FNC_VALUES 1 FLOAT64_IEEE COLUMN_DIR DIRECT /end RECORD_LAYOUT
/begin RECORD_LAYOUT float32__BASE_TYPE_RL FNC_VALUES 1 FLOAT32_IEEE COLUMN_DIR DIRECT /end RECORD_LAYOUT
/begin RECORD_LAYOUT boolean__BASE_TYPE_RL FNC_VALUES 1 UBYTE COLUMN_DIR DIRECT /end RECORD_LAYOUT
/begin RECORD_LAYOUT uint8__BASE_TYPE_RL FNC_VALUES 1 UBYTE COLUMN_DIR DIRECT /end RECORD_LAYOUT
/begin RECORD_LAYOUT SWORD_2__BASE_TYPE_RL FNC_VALUES 1 SWORD COLUMN_DIR DIRECT /end RECORD_LAYOUT
/begin RECORD_LAYOUT SLONG_2__BASE_TYPE_RL FNC_VALUES 1 SLONG COLUMN_DIR DIRECT /end RECORD_LAYOUT
/begin RECORD_LAYOUT SBYTE_2__BASE_TYPE_RL FNC_VALUES 1 SBYTE COLUMN_DIR DIRECT /end RECORD_LAYOUT
/begin RECORD_LAYOUT UBYTE_2__BASE_TYPE_RL FNC_VALUES 1 UBYTE COLUMN_DIR DIRECT /end RECORD_LAYOUT
/begin RECORD_LAYOUT ULONG_2__BASE_TYPE_RL FNC_VALUES 1 ULONG COLUMN_DIR DIRECT /end RECORD_LAYOUT
/begin RECORD_LAYOUT EcuM_Scalar_UBYTE FNC_VALUES 1 UBYTE COLUMN_DIR DIRECT /end RECORD_LAYOUT
/begin RECORD_LAYOUT FLOAT32_IEEE_2__BASE_TYPE_RL FNC_VALUES 1 FLOAT32_IEEE COLUMN_DIR DIRECT /end RECORD_LAYOUT
/begin RECORD_LAYOUT FLOAT64_IEEE_2__BASE_TYPE_RL FNC_VALUES 1 FLOAT64_IEEE COLUMN_DIR DIRECT /end RECORD_LAYOUT
/begin RECORD_LAYOUT UWORD_2__BASE_TYPE_RL FNC_VALUES 1 UWORD COLUMN_DIR DIRECT /end RECORD_LAYOUT
/begin MEASUREMENT ActuatorSWC_CC_StateNew_Value "" UBYTE boolean 0 0 0 1 ECU_ADDRESS 0x0 SYMBOL_LINK "Rte_Signal_3" 0 /end MEASUREMENT
/begin MEASUREMENT ActuatorSWC_TargetSpeed_Value "A speed value in km/h" FLOAT32_IEEE VOID 0 0 -3.402823e+38 3.402823e+38 ECU_ADDRESS 0x0 SYMBOL_LINK "Rte_Signal_6" 0 /end MEASUREMENT
/begin MEASUREMENT SensorSWC_Counter_Value "" UBYTE VOID 0 0 0 255 ECU_ADDRESS 0x0 /* @MemoryAddress@Rte_Signal_4@ */ SYMBOL_LINK "Rte_Signal_4" 0 /end MEASUREMENT
/begin MEASUREMENT CruiseControl_AcceleratorPedal_Value "" UBYTE boolean 0 0 0 1 ECU_ADDRESS 0x0 /* @MemoryAddress@Rte_Signal_7@ */ SYMBOL_LINK "Rte_Signal_7" 0 /end MEASUREMENT
/begin MEASUREMENT SensorSWC_BrakePedal_Value "" UBYTE boolean 0 0 0 1 ECU_ADDRESS 0x0 /* @MemoryAddress@Rte_Signal_8@ */ SYMBOL_LINK "Rte_Signal_8" 0 /end MEASUREMENT
/begin MEASUREMENT SensorSWC_DistanceLeading_Value "A distance value in meters" FLOAT32_IEEE VOID 0 0 -3.402823e+38 3.402823e+38 ECU_ADDRESS 0x0 /* @MemoryAddress@Rte_Signal_11@ */ SYMBOL_LINK "Rte_Signal_11" 0 /end MEASUREMENT
/begin MEASUREMENT CruiseControl_CC_StateNew_Value "" UBYTE boolean 0 0 0 1 ECU_ADDRESS 0x0 SYMBOL_LINK "Rte_Signal_3" 0 /end MEASUREMENT
/begin MEASUREMENT EmergencyBrake1_DistanceLeading_Value "A distance value in meters" FLOAT32_IEEE VOID 0 0 -3.402823e+38 3.402823e+38 ECU_ADDRESS 0x0 /* @MemoryAddress@Rte_Signal_11@ */ SYMBOL_LINK "Rte_Signal_11" 0 /end MEASUREMENT
/begin MEASUREMENT ActuatorSWC_Accelerate_Value "" UBYTE boolean 0 0 0 1 ECU_ADDRESS 0x0 /* @MemoryAddress@Rte_Signal_1@ */ SYMBOL_LINK "Rte_Signal_1" 0 /end MEASUREMENT
/begin MEASUREMENT CruiseControl_Accelerate_Value "" UBYTE boolean 0 0 0 1 ECU_ADDRESS 0x0 /* @MemoryAddress@Rte_Signal_1@ */ SYMBOL_LINK "Rte_Signal_1" 0 /end MEASUREMENT
/begin MEASUREMENT TargetSpeedControl_TargetSpeedButtonState_Value "the state of the CC target speed adjustment button(s)\r\n\r\n1 = increase target speed by 5 km/h\r\n2 = decrease target speed by 5 km/h\r\nall other values = no action\r\n" UBYTE VOID 0 0 0 255 ECU_ADDRESS 0x0 /* @MemoryAddress@Rte_Signal_12@ */ SYMBOL_LINK "Rte_Signal_12" 0 /end MEASUREMENT
/begin MEASUREMENT ActuatorSWC_EmergencyBrake_Value "" UBYTE boolean 0 0 0 1 ECU_ADDRESS 0x0 /* @MemoryAddress@Rte_Signal_5@ */ SYMBOL_LINK "Rte_Signal_5" 0 /end MEASUREMENT
/begin MEASUREMENT EmergencyBrake1_CurrentSpeed_Value "A speed value in km/h" FLOAT32_IEEE VOID 0 0 -3.402823e+38 3.402823e+38 ECU_ADDRESS 0x0 SYMBOL_LINK "Rte_Signal_10" 0 /end MEASUREMENT
/begin MEASUREMENT ActuatorSWC_Counter_Value "" UBYTE VOID 0 0 0 255 ECU_ADDRESS 0x0 /* @MemoryAddress@Rte_Signal_4@ */ SYMBOL_LINK "Rte_Signal_4" 0 /end MEASUREMENT
/begin MEASUREMENT CruiseControl_CC_State_Value "" UBYTE boolean 0 0 0 1 ECU_ADDRESS 0x0 /* @MemoryAddress@Rte_Signal_9@ */ SYMBOL_LINK "Rte_Signal_9" 0 /end MEASUREMENT
/begin MEASUREMENT SensorSWC_CC_State_Value "" UBYTE boolean 0 0 0 1 ECU_ADDRESS 0x0 /* @MemoryAddress@Rte_Signal_9@ */ SYMBOL_LINK "Rte_Signal_9" 0 /end MEASUREMENT
/begin MEASUREMENT SensorSWC_TargetSpeedButtonState_Value "the state of the CC target speed adjustment button(s)\r\n\r\n1 = increase target speed by 5 km/h\r\n2 = decrease target speed by 5 km/h\r\nall other values = no action\r\n" UBYTE VOID 0 0 0 255 ECU_ADDRESS 0x0 /* @MemoryAddress@Rte_Signal_12@ */ SYMBOL_LINK "Rte_Signal_12" 0 /end MEASUREMENT
/begin MEASUREMENT TargetSpeedControl_TargetSpeed_Value "A speed value in km/h" FLOAT32_IEEE VOID 0 0 -3.402823e+38 3.402823e+38 ECU_ADDRESS 0x0 SYMBOL_LINK "Rte_Signal_6" 0 /end MEASUREMENT
/begin MEASUREMENT SensorSWC_CurrentSpeed_Value "A speed value in km/h" FLOAT32_IEEE VOID 0 0 -3.402823e+38 3.402823e+38 ECU_ADDRESS 0x0 SYMBOL_LINK "Rte_Signal_10" 0 /end MEASUREMENT
/begin MEASUREMENT EmergencyBrake1_CC_StateNew_Value "" UBYTE boolean 0 0 0 1 ECU_ADDRESS 0x0 SYMBOL_LINK "Rte_Signal_3" 0 /end MEASUREMENT
/begin MEASUREMENT SensorSWC_AcceleratorPedal_Value "" UBYTE boolean 0 0 0 1 ECU_ADDRESS 0x0 /* @MemoryAddress@Rte_Signal_7@ */ SYMBOL_LINK "Rte_Signal_7" 0 /end MEASUREMENT
/begin MEASUREMENT ActuatorSWC_Brake_Value "" UBYTE boolean 0 0 0 1 ECU_ADDRESS 0x0 /* @MemoryAddress@Rte_Signal_2@ */ SYMBOL_LINK "Rte_Signal_2" 0 /end MEASUREMENT
/begin MEASUREMENT CruiseControl_BrakePedal_Value "" UBYTE boolean 0 0 0 1 ECU_ADDRESS 0x0 /* @MemoryAddress@Rte_Signal_8@ */ SYMBOL_LINK "Rte_Signal_8" 0 /end MEASUREMENT
/begin MEASUREMENT CruiseControl_TargetSpeed_Value "A speed value in km/h" FLOAT32_IEEE VOID 0 0 -3.402823e+38 3.402823e+38 ECU_ADDRESS 0x0 SYMBOL_LINK "Rte_Signal_6" 0 /end MEASUREMENT
/begin MEASUREMENT EmergencyBrake1_EmergencyBrake_Value "" UBYTE boolean 0 0 0 1 ECU_ADDRESS 0x0 /* @MemoryAddress@Rte_Signal_5@ */ SYMBOL_LINK "Rte_Signal_5" 0 /end MEASUREMENT
/begin MEASUREMENT CruiseControl_CurrentSpeed_Value "A speed value in km/h" FLOAT32_IEEE VOID 0 0 -3.402823e+38 3.402823e+38 ECU_ADDRESS 0x0 SYMBOL_LINK "Rte_Signal_10" 0 /end MEASUREMENT
/begin MEASUREMENT CruiseControl_Brake_Value "" UBYTE boolean 0 0 0 1 ECU_ADDRESS 0x0 /* @MemoryAddress@Rte_Signal_2@ */ SYMBOL_LINK "Rte_Signal_2" 0 /end MEASUREMENT
/begin MEASUREMENT NumberPostRunRequests "Current number of POST RUN requests of the EcuM" UBYTE __Identity 0 0 0 255 ECU_ADDRESS 0x0 /* @MemoryAddress@EcuM_CurrentNumberOfPostRunRequests + UINT8(0)[0]@ */ SYMBOL_LINK "EcuM_CurrentNumberOfPostRunRequests + UINT8(0)[0]" 0 /end MEASUREMENT
/begin MEASUREMENT CurrentState "Current state of the EcuM" UBYTE EcuM_CurrentStateScaling 0 0 0 255 ECU_ADDRESS 0x0 /* @MemoryAddress@EcuM_CurrentState + UINT8(0)[0]@ */ SYMBOL_LINK "EcuM_CurrentState + UINT8(0)[0]" 0 /end MEASUREMENT
/begin CHARACTERISTIC NextMode "The EcuM switches to this mode unconditionally." VALUE 0x0 /* @MemoryAddress@EcuM_NextMode@ */ EcuM_Scalar_UBYTE 0 EcuM_NextModeScaling 0 255 SYMBOL_LINK "EcuM_NextMode" 0 /end CHARACTERISTIC
/begin MEASUREMENT NumberRunRequests "Current number of RUN requests of the EcuM" UBYTE __Identity 0 0 0 255 ECU_ADDRESS 0x0 /* @MemoryAddress@EcuM_CurrentNumberOfRunRequests + UINT8(0)[0]@ */ SYMBOL_LINK "EcuM_CurrentNumberOfRunRequests + UINT8(0)[0]" 0 /end MEASUREMENT
/begin GROUP ActuatorSWC "" ROOT
 /begin REF_MEASUREMENT ActuatorSWC_CC_StateNew_Value ActuatorSWC_TargetSpeed_Value ActuatorSWC_Accelerate_Value ActuatorSWC_EmergencyBrake_Value ActuatorSWC_Counter_Value ActuatorSWC_Brake_Value /end REF_MEASUREMENT
/end GROUP
/begin GROUP SensorSWC "" ROOT
 /begin REF_MEASUREMENT SensorSWC_Counter_Value SensorSWC_BrakePedal_Value SensorSWC_DistanceLeading_Value SensorSWC_CC_State_Value SensorSWC_TargetSpeedButtonState_Value SensorSWC_CurrentSpeed_Value SensorSWC_AcceleratorPedal_Value /end REF_MEASUREMENT
/end GROUP
/begin GROUP CruiseControl "" ROOT
 /begin REF_MEASUREMENT CruiseControl_AcceleratorPedal_Value CruiseControl_CC_StateNew_Value CruiseControl_Accelerate_Value CruiseControl_CC_State_Value CruiseControl_BrakePedal_Value CruiseControl_TargetSpeed_Value CruiseControl_CurrentSpeed_Value CruiseControl_Brake_Value /end REF_MEASUREMENT
/end GROUP
/begin GROUP EmergencyBrake "" ROOT
 /begin REF_MEASUREMENT EmergencyBrake1_DistanceLeading_Value EmergencyBrake1_CurrentSpeed_Value EmergencyBrake1_CC_StateNew_Value EmergencyBrake1_EmergencyBrake_Value /end REF_MEASUREMENT
/end GROUP
/begin GROUP TargetSpeedControl "" ROOT
 /begin REF_MEASUREMENT TargetSpeedControl_TargetSpeedButtonState_Value TargetSpeedControl_TargetSpeed_Value /end REF_MEASUREMENT
/end GROUP
/begin FUNCTION BswModules "" /begin SUB_FUNCTION EcuM /end SUB_FUNCTION /end FUNCTION
/begin FUNCTION EcuM "" /begin REF_CHARACTERISTIC NextMode /end REF_CHARACTERISTIC /begin LOC_MEASUREMENT NumberPostRunRequests CurrentState NumberRunRequests /end LOC_MEASUREMENT /end FUNCTION
/end MODULE
/end PROJECT
