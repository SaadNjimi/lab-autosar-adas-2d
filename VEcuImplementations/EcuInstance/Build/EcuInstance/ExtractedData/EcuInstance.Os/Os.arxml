AUTOSAR XML (schema 4-3-0)
package /ArPackage/EcuConfiguration_EcuInstance
  module config Os: ecuc-def-edition=3.1.0, module-description=BswImpl_Os
    OsOS: OsStackMonitoring=0, OsStatus=EXTENDED, OsUseGetServiceId=0, OsUseParameterAccess=0, OsUseResScheduler=1
      OsHooks: OsErrorHook=0, OsPostTaskHook=0, OsPreTaskHook=0, OsShutdownHook=0, OsStartupHook=0
    3 x OsTask, all with OsTaskActivation=1, OsTaskStackSize=16384:
      Task0_10ms: OsTaskPriority=10, OsTaskSchedule=FULL, OsTaskPeriod=0.01
      Task1: OsTaskPriority=10, OsTaskSchedule=FULL, OsTaskEventRef=Rte_OsEvent_0, OsTaskEventRef=Rte_OsEvent_1
      EcuM_StartupTwoTask: OsTaskPriority=2147483647, OsTaskSchedule=NON
        OsTaskAutostart: OsTaskAppModeRef=OSDEFAULTAPPMODE
    OSDEFAULTAPPMODE (OsAppMode)
    MainFunctionTask3_1ms (OsTask): OsTaskActivation=1, OsTaskPriority=15, OsTaskStackSize=16384, OsTaskSchedule=FULL, OsTaskPeriod=0.001
    Rte_OsAlarm_Cyclic_MainFunctionTask3_1ms (OsAlarm): OsAlarmCounterRef=SystemTimer
      OsAlarmAction
        OsAlarmActivateTask: OsAlarmActivateTaskRef=MainFunctionTask3_1ms
    Rte_OsAlarm_Cyclic_Task0_10ms (OsAlarm): OsAlarmCounterRef=SystemTimer
      OsAlarmAction
        OsAlarmActivateTask: OsAlarmActivateTaskRef=Task0_10ms
    SystemTimer (OsCounter): OsCounterMaxAllowedValue=65535, OsCounterMinCycle=1, OsCounterTicksPerBase=1, OsCounterType=HARDWARE, OsSecondsPerTick=0.001
    Rte_OsEvent_0 (OsEvent)
    Rte_OsEvent_1 (OsEvent)
