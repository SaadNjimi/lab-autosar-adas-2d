AUTOSAR XML (schema 4-3-0)
package /ArPackage/EcuConfiguration_EcuInstance
  module config Sab: ecuc-def-edition=3.1.0
    SabStateManagement: SabStartupFunction=EcuM_Init
    SabDataTypeConfiguration: Sab_RteTypeContains_Bool_Intxx_Floatxx=0, Sab_RteTypeContains_UIntxx=0
