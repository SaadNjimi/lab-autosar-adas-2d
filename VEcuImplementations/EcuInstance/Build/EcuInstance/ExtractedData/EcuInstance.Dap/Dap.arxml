AUTOSAR XML (schema 4-3-0)
package /ArPackage/EcuConfiguration_EcuInstance
  module config Dap: ecuc-def-edition=3.1.0
    TestPoints (DapContext): DapContextKind=TestPoints
