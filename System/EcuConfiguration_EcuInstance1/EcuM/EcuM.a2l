/**************************************************************************************************\
*** System : System
*** ECU : EcuInstance
*** Configuration : EcuConfiguration_EcuInstance1
*** Generated by SystemDesk 5.6.0.13023
*** Generation date: 2025-06-11 08:50:22
*** Copyright (c) 2018 dSPACE GmbH
\**************************************************************************************************/ ASAP2_VERSION 1 61
/* Version 1.61 */
/begin PROJECT EcuM ""
/begin HEADER "" /end HEADER
/begin MODULE EcuM ""
/begin MEASUREMENT CurrentState "Current state of the EcuM" UBYTE EcuM_CurrentStateScaling 0 0 0 255 ECU_ADDRESS 0x0000 /* @MemoryAddress@EcuM_CurrentState @ */ SYMBOL_LINK "EcuM_CurrentState" 0 /end MEASUREMENT
/begin MEASUREMENT NumberRunRequests "Current number of RUN requests of the EcuM" UBYTE __Identity 0 0 0 255 ECU_ADDRESS 0x0000 /* @MemoryAddress@EcuM_CurrentNumberOfRunRequests @ */ SYMBOL_LINK "EcuM_CurrentNumberOfRunRequests" 0 /end MEASUREMENT
/begin MEASUREMENT NumberPostRunRequests "Current number of POST RUN requests of the EcuM" UBYTE __Identity 0 0 0 255 ECU_ADDRESS 0x0000 /* @MemoryAddress@EcuM_CurrentNumberOfPostRunRequests @ */ SYMBOL_LINK "EcuM_CurrentNumberOfPostRunRequests" 0 /end MEASUREMENT
/begin RECORD_LAYOUT EcuM_Scalar_UBYTE FNC_VALUES 1 UBYTE COLUMN_DIR DIRECT /end RECORD_LAYOUT
/begin CHARACTERISTIC NextMode /* Long Identifier */ "The EcuM switches to this mode unconditionally." /* Type */ VALUE /* Memory Address */ 0x0000 /* @MemoryAddress@EcuM_NextMode@ */ /* Record Layout */ EcuM_Scalar_UBYTE /* Maximum Difference */ 0 /* Conversion Method */ EcuM_NextModeScaling /* Lower Limit */ 0 /* Upper Limit */ 255 SYMBOL_LINK "EcuM_NextMode" 0 /end CHARACTERISTIC
/begin COMPU_METHOD /* Name of CompuMethod */ __Identity "" /* Conversion Type */ RAT_FUNC /* Format */ "%%g" /* Units */ "" /* Coefficients */ COEFFS 0 1 0 0 0 1 /end COMPU_METHOD
/begin COMPU_METHOD EcuM_CurrentStateScaling "" TAB_VERB "%g" "" COMPU_TAB_REF EcuM_CurrentStateScaling_COMPU_VTAB /end COMPU_METHOD
/begin COMPU_VTAB_RANGE EcuM_CurrentStateScaling_COMPU_VTAB "" 21 16 16 "STARTUP" 17 17 "STARTUP_ONE" 18 18 "STARTUP_TWO" 32 32 "WAKEUP" 33 33 "WAKEUP_ONE" 34 34 "WAKEUP_VALIDATION" 35 35 "WAKEUP_REACTION" 36 36 "WAKEUP_TWO" 37 37 "WAKEUP_WAKESLEEP" 38 38 "WAKEUP_TTII" 48 48 "RUN" 50 50 "APP_RUN" 51 51 "APP_POST_RUN" 64 64 "SHUTDOWN" 68 68 "PREP_SHUTDOWN" 73 73 "GO_SLEEP" 77 77 "GO_OFF_ONE" 78 78 "GO_OFF_TWO" 80 80 "SLEEP" 128 128 "OFF" 144 144 "RESET" DEFAULT_VALUE "INVALID_STATE" /end COMPU_VTAB_RANGE
/begin COMPU_METHOD EcuM_NextModeScaling "" TAB_VERB "%g" "" COMPU_TAB_REF EcuM_NextModeScaling_COMPU_VTAB /end COMPU_METHOD
/begin COMPU_VTAB_RANGE EcuM_NextModeScaling_COMPU_VTAB "" 6 0 0 "POST_RUN" 1 1 "RUN" 2 2 "SHUTDOWN" 3 3 "SLEEP" 4 4 "STARTUP" 5 5 "WAKE_SLEEP" DEFAULT_VALUE "STARTUP" /end COMPU_VTAB_RANGE
/begin FUNCTION BswModules "Variables of BSW modules" /begin SUB_FUNCTION EcuM /end SUB_FUNCTION /end FUNCTION
/begin FUNCTION EcuM "Variables of module EcuM" /begin REF_CHARACTERISTIC NextMode /end REF_CHARACTERISTIC /begin LOC_MEASUREMENT CurrentState NumberRunRequests NumberPostRunRequests /end LOC_MEASUREMENT /end FUNCTION
/end MODULE
/end PROJECT
