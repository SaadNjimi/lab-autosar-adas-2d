AUTOSAR XML (schema 4-3-0)
# Copyright 2018 by dSPACE GmbH. All rights reserved.
package /AUTOSAR_EcuM/BswImplementations
  bsw implementation BswImpl_EcuM: programming-language=C, sw-version=1.0.0.0, swc-bsw-mapping=SBM_EcuM, behavior=IB_EcuM
    code-descriptors:
      code EcuM
        artifact-descriptors:
          short-label=EcuM.c, category=SWSRC
          short-label=EcuM_Callout.c, category=SWSRC
          short-label=EcuM_PBcfg.c, category=SWSRC
          short-label=EcuM_States.c, category=SWSRC
          short-label=EcuM.h, category=SWHDR
          short-label=EcuM_Callout.h, category=SWHDR
          short-label=EcuM_Cbk.h, category=SWHDR
          short-label=EcuM_Cfg.h, category=SWHDR
          short-label=EcuM_Types.h, category=SWHDR
          short-label=EcuM_Internal.h, category=SWHDR
    generated-artifacts:
      dependency on artifact EcuM_PlatformDescription: artifact-descriptor={short-label=EcuM_PlatformDescription.xml, category=OTHER}
    resource consumption ResourceConsumption
package /AUTOSAR_EcuM/BswModuleDescriptions
  bsw module description EcuM
    implemented-entrys:
      EcuM_MainFunction
      EcuM_ClearWakeupEvent
      EcuM_GetBootTarget
      EcuM_GetExpiredWakeupEvents
      EcuM_GetLastShutdownTarget
      EcuM_GetPendingWakeupEvents
      EcuM_GetShutdownTarget
      EcuM_GetState
      EcuM_GetStatusOfWakeupSource
      EcuM_GetValidatedWakeupEvents
      EcuM_Init
      EcuM_KillAllPostRUNRequests
      EcuM_KillAllRUNRequests
      EcuM_ReleasePOST_RUN
      EcuM_ReleaseRUN
      EcuM_RequestPOST_RUN
      EcuM_RequestRUN
      EcuM_SelectBootTarget
      EcuM_SelectShutdownTarget
      EcuM_Shutdown
      EcuM_StartupTwo
    provided-client-server-entrys:
      20 x bsw module client server entry, all with is-synchronous=true:
        CSE_EcuM_ClearWakeupEvent: encapsulated-entry=EcuM_ClearWakeupEvent, is-reentrant=false
        CSE_EcuM_GetBootTarget: encapsulated-entry=EcuM_GetBootTarget, is-reentrant=true
        CSE_EcuM_GetExpiredWakeupEvents: encapsulated-entry=EcuM_GetExpiredWakeupEvents, is-reentrant=false
        CSE_EcuM_GetLastShutdownTarget: encapsulated-entry=EcuM_GetLastShutdownTarget, is-reentrant=true
        CSE_EcuM_GetPendingWakeupEvents: encapsulated-entry=EcuM_GetPendingWakeupEvents, is-reentrant=false
        CSE_EcuM_GetShutdownTarget: encapsulated-entry=EcuM_GetShutdownTarget, is-reentrant=true
        CSE_EcuM_GetState: encapsulated-entry=EcuM_GetState, is-reentrant=true
        CSE_EcuM_GetStatusOfWakeupSource: encapsulated-entry=EcuM_GetStatusOfWakeupSource, is-reentrant=true
        CSE_EcuM_GetValidatedWakeupEvents: encapsulated-entry=EcuM_GetValidatedWakeupEvents, is-reentrant=false
        CSE_EcuM_Init: encapsulated-entry=EcuM_Init, is-reentrant=true
        CSE_EcuM_KillAllPostRUNRequests: encapsulated-entry=EcuM_KillAllPostRUNRequests, is-reentrant=true
        CSE_EcuM_KillAllRUNRequests: encapsulated-entry=EcuM_KillAllRUNRequests, is-reentrant=true
        CSE_EcuM_ReleasePOST_RUN: encapsulated-entry=EcuM_ReleasePOST_RUN, is-reentrant=true
        CSE_EcuM_ReleaseRUN: encapsulated-entry=EcuM_ReleaseRUN, is-reentrant=true
        CSE_EcuM_RequestPOST_RUN: encapsulated-entry=EcuM_RequestPOST_RUN, is-reentrant=true
        CSE_EcuM_RequestRUN: encapsulated-entry=EcuM_RequestRUN, is-reentrant=true
        CSE_EcuM_SelectBootTarget: encapsulated-entry=EcuM_SelectBootTarget, is-reentrant=true
        CSE_EcuM_SelectShutdownTarget: encapsulated-entry=EcuM_SelectShutdownTarget, is-reentrant=true
        CSE_EcuM_Shutdown: encapsulated-entry=EcuM_Shutdown, is-reentrant=true
        CSE_EcuM_StartupTwo: encapsulated-entry=EcuM_StartupTwo, is-reentrant=false
    bsw internal behavior IB_EcuM
      bsw schedulable entity EcuM_MainFunction: implemented-entry=EcuM_MainFunction
      20 x bsw called entity:
        EcuM_ClearWakeupEvent: implemented-entry=EcuM_ClearWakeupEvent
        EcuM_GetBootTarget: implemented-entry=EcuM_GetBootTarget
        EcuM_GetExpiredWakeupEvents: implemented-entry=EcuM_GetExpiredWakeupEvents
        EcuM_GetLastShutdownTarget: implemented-entry=EcuM_GetLastShutdownTarget
        EcuM_GetPendingWakeupEvents: implemented-entry=EcuM_GetPendingWakeupEvents
        EcuM_GetShutdownTarget: implemented-entry=EcuM_GetShutdownTarget
        EcuM_GetState: implemented-entry=EcuM_GetState
        EcuM_GetStatusOfWakeupSource: implemented-entry=EcuM_GetStatusOfWakeupSource
        EcuM_GetValidatedWakeupEvents: implemented-entry=EcuM_GetValidatedWakeupEvents
        EcuM_Init: implemented-entry=EcuM_Init
        EcuM_KillAllPostRUNRequests: implemented-entry=EcuM_KillAllPostRUNRequests
        EcuM_KillAllRUNRequests: implemented-entry=EcuM_KillAllRUNRequests
        EcuM_ReleasePOST_RUN: implemented-entry=EcuM_ReleasePOST_RUN
        EcuM_ReleaseRUN: implemented-entry=EcuM_ReleaseRUN
        EcuM_RequestPOST_RUN: implemented-entry=EcuM_RequestPOST_RUN
        EcuM_RequestRUN: implemented-entry=EcuM_RequestRUN
        EcuM_SelectBootTarget: implemented-entry=EcuM_SelectBootTarget
        EcuM_SelectShutdownTarget: implemented-entry=EcuM_SelectShutdownTarget
        EcuM_Shutdown: implemented-entry=EcuM_Shutdown
        EcuM_StartupTwo: implemented-entry=EcuM_StartupTwo
      bsw timing event EcuM_MainFunction_Event: starts-on-event=EcuM_MainFunction, period=0.001
      20 x bsw operation invoked event:
        EcuM_ClearWakeupEvent_Event: starts-on-event=EcuM_ClearWakeupEvent, entry=CSE_EcuM_ClearWakeupEvent
        EcuM_GetBootTarget_Event: starts-on-event=EcuM_GetBootTarget, entry=CSE_EcuM_GetBootTarget
        EcuM_GetExpiredWakeupEvents_Event: starts-on-event=EcuM_GetExpiredWakeupEvents, entry=CSE_EcuM_GetExpiredWakeupEvents
        EcuM_GetLastShutdownTarget_Event: starts-on-event=EcuM_GetLastShutdownTarget, entry=CSE_EcuM_GetLastShutdownTarget
        EcuM_GetPendingWakeupEvents_Event: starts-on-event=EcuM_GetPendingWakeupEvents, entry=CSE_EcuM_GetPendingWakeupEvents
        EcuM_GetShutdownTarget_Event: starts-on-event=EcuM_GetShutdownTarget, entry=CSE_EcuM_GetShutdownTarget
        EcuM_GetState_Event: starts-on-event=EcuM_GetState, entry=CSE_EcuM_GetState
        EcuM_GetStatusOfWakeupSource_Event: starts-on-event=EcuM_GetStatusOfWakeupSource, entry=CSE_EcuM_GetStatusOfWakeupSource
        EcuM_GetValidatedWakeupEvents_Event: starts-on-event=EcuM_GetValidatedWakeupEvents, entry=CSE_EcuM_GetValidatedWakeupEvents
        EcuM_Init_Event: starts-on-event=EcuM_Init, entry=CSE_EcuM_Init
        EcuM_KillAllPostRUNRequests_Event: starts-on-event=EcuM_KillAllPostRUNRequests, entry=CSE_EcuM_KillAllPostRUNRequests
        EcuM_KillAllRUNRequests_Event: starts-on-event=EcuM_KillAllRUNRequests, entry=CSE_EcuM_KillAllRUNRequests
        EcuM_ReleasePOST_RUN_Event: starts-on-event=EcuM_ReleasePOST_RUN, entry=CSE_EcuM_ReleasePOST_RUN
        EcuM_ReleaseRUN_Event: starts-on-event=EcuM_ReleaseRUN, entry=CSE_EcuM_ReleaseRUN
        EcuM_RequestPOST_RUN_Event: starts-on-event=EcuM_RequestPOST_RUN, entry=CSE_EcuM_RequestPOST_RUN
        EcuM_RequestRUN_Event: starts-on-event=EcuM_RequestRUN, entry=CSE_EcuM_RequestRUN
        EcuM_SelectBootTarget_Event: starts-on-event=EcuM_SelectBootTarget, entry=CSE_EcuM_SelectBootTarget
        EcuM_SelectShutdownTarget_Event: starts-on-event=EcuM_SelectShutdownTarget, entry=CSE_EcuM_SelectShutdownTarget
        EcuM_Shutdown_Event: starts-on-event=EcuM_Shutdown, entry=CSE_EcuM_Shutdown
        EcuM_StartupTwo_Event: starts-on-event=EcuM_StartupTwo, entry=CSE_EcuM_StartupTwo
package /AUTOSAR_EcuM/BswModuleEntrys
  21 x bsw module entry:
    EcuM_MainFunction: service-id=24, is-reentrant=false, is-synchronous=false, call-type=SCHEDULED, execution-context=TASK  # The purpose of this service is to implement all activities of the ECU State Manager while the OS is up and running.
    EcuM_ClearWakeupEvent: service-id=22, is-reentrant=false, is-synchronous=true, call-type=REGULAR  # Clears wakeup events.
      sw service arg sources: direction=IN, implementation-data-type=EcuM_WakeupSourceType  # Events to be cleared
    EcuM_GetBootTarget: service-id=19, is-reentrant=true, is-synchronous=true, call-type=REGULAR  # EcuM_GetBootTarget returns the current boot target - see EcuM_SelectBootTarget. EcuM_GetBootTarget is part of the ECU Manager Module port interface.
      return type Std_ReturnType: direction=OUT, implementation-data-type=Std_ReturnType
      sw service arg target: category=DATA_REFERENCE, direction=OUT, sw-pointer-target-props={target-category=TYPE_REFERENCE, implementation-data-type=EcuM_BootTargetType}  # The currently selected boot target.
    EcuM_GetExpiredWakeupEvents: service-id=25, is-reentrant=false, is-synchronous=true, call-type=REGULAR  # Gets expired wakeup events.
      return type EcuM_WakeupSourceType: direction=OUT, implementation-data-type=EcuM_WakeupSourceType
    EcuM_GetLastShutdownTarget: service-id=8, is-reentrant=true, is-synchronous=true, call-type=REGULAR  # EcuM_GetLastShutdownTarget returns the shutdown target of the previous shutdown process. EcuM_GetLastShutdownTarget is part of the ECU Manager Module port interface.
      return type Std_ReturnType: direction=OUT, implementation-data-type=Std_ReturnType
      sw service arg shutdownTarget: category=DATA_REFERENCE, direction=OUT, sw-pointer-target-props={target-category=TYPE_REFERENCE, implementation-data-type=EcuM_StateType}  # One of these values is returned: * ECUM_STATE_SLEEP * ECUM_STATE_RESET * ECUM_STATE_OFF
      sw service arg sleepMode: category=DATA_REFERENCE, direction=OUT, sw-pointer-target-props={target-category=TYPE_REFERENCE, implementation-data-type=uint8}  # If the out parameter \"shutdownTarget\" is ECUM_STATE_SLEEP, sleepMode tells which of the configured sleep modes was actually chosen. If \"shutdownTarget\" is ECUM_STATE_RESET, sleepMode tells which of the configured reset modes was actually chosen.
    EcuM_GetPendingWakeupEvents: service-id=13, is-reentrant=false, is-synchronous=true, call-type=REGULAR  # Gets pending wakeup events.
      return type EcuM_WakeupSourceType: direction=OUT, implementation-data-type=EcuM_WakeupSourceType
    EcuM_GetShutdownTarget: service-id=9, is-reentrant=true, is-synchronous=true, call-type=REGULAR  # EcuM_GetShutdownTarget returns the currently selected shutdown target as set by EcuM_SelectShutdownTarget. EcuM_GetShutdownTarget is part of the ECU Manager Module port interface.
      return type Std_ReturnType: direction=OUT, implementation-data-type=Std_ReturnType
      sw service arg shutdownTarget: category=DATA_REFERENCE, direction=OUT, sw-pointer-target-props={target-category=TYPE_REFERENCE, implementation-data-type=EcuM_StateType}  # One of these values is returned: * ECUM_STATE_SLEEP * ECUM_STATE_RESET * ECUM_STATE_OFF
      sw service arg sleepMode: category=DATA_REFERENCE, direction=OUT, sw-pointer-target-props={target-category=TYPE_REFERENCE, implementation-data-type=uint8}  # If the out parameter \"shutdownTarget\" is ECUM_STATE_SLEEP, sleepMode tells which of the configured sleep modes was actually chosen. If \"shutdownTarget\" is ECUM_STATE_RESET, sleepMode tells which of the configured reset modes was actually chosen.
    EcuM_GetState: service-id=7, is-reentrant=true, is-synchronous=true, call-type=REGULAR  # Gets a state.
      return type Std_ReturnType: direction=OUT, implementation-data-type=Std_ReturnType
      sw service arg state: category=DATA_REFERENCE, direction=OUT, sw-pointer-target-props={target-category=TYPE_REFERENCE, implementation-data-type=EcuM_StateType}  # The value of the internal state variable.
    EcuM_GetStatusOfWakeupSource: service-id=23, is-reentrant=true, is-synchronous=true, call-type=REGULAR  # The sum status shall be computed according to the following algorithm: If (EcuM_GetValidatedWakeupEvents() AND sources) is not 0 then return ECUM_WKSTATUS_VALIDATED. If (EcuM_GetPendingWakeupEvents() AND sources) is not 0 then return ECUM_WKSTATUS_PENDING. If (EcuM_GetExpiredWakeupEvents() AND sources) is not 0 then return ECUM_WKSTATUS_EXPIRED. Otherwise, return ECUM_WKSTATUS_NONE.
      return type EcuM_WakeupStatusType: direction=OUT, implementation-data-type=EcuM_WakeupStatusType
      sw service arg sources: direction=IN, implementation-data-type=EcuM_WakeupSourceType  # The sources for which the status is returned
    EcuM_GetValidatedWakeupEvents: service-id=21, is-reentrant=false, is-synchronous=true, call-type=REGULAR  # Gets validated wakeup events.
      return type EcuM_WakeupSourceType: direction=OUT, implementation-data-type=EcuM_WakeupSourceType
    EcuM_Init: service-id=1, is-reentrant=true, is-synchronous=true, call-type=REGULAR  # Initializes the ECU state manager and carries out the startup procedure. The function will never return (it calls StartOS)
    EcuM_KillAllPostRUNRequests: service-id=42, is-reentrant=true, is-synchronous=true, call-type=REGULAR  # This function unconditionally releases all pending requests to PostRUN.
    EcuM_KillAllRUNRequests: service-id=5, is-reentrant=true, is-synchronous=true, call-type=REGULAR  # The benefit of this function over an ECU reset is that the shutdown sequence is executed, which e.g. takes care of writing back NV memory contents.
    EcuM_ReleasePOST_RUN: service-id=11, is-reentrant=true, is-synchronous=true, call-type=REGULAR  # Releases a POST RUN request previously done with a call to EcuM_RequestPOST_RUN. The service is intended for implementing AUTOSAR ports.
      return type Std_ReturnType: direction=OUT, implementation-data-type=Std_ReturnType
      sw service arg user: direction=IN, implementation-data-type=EcuM_UserType  # ID of the entity releasing the POST RUN state.
    EcuM_ReleaseRUN: service-id=4, is-reentrant=true, is-synchronous=true, call-type=REGULAR  # Releases a RUN request previously done with a call to EcuM_RequestRUN. The service is intended for implementing AUTOSAR ports.
      return type Std_ReturnType: direction=OUT, implementation-data-type=Std_ReturnType
      sw service arg user: direction=IN, implementation-data-type=EcuM_UserType  # ID of the entity releasing the RUN state.
    EcuM_RequestPOST_RUN: service-id=10, is-reentrant=true, is-synchronous=true, call-type=REGULAR  # Places a request for the POST RUN state. Requests can be placed by every user made known to the state manager at configuration time. Requests for RUN and POST RUN must be tracked independently (in other words: two independent variables). The service is intended for implementing AUTOSAR ports.
      return type Std_ReturnType: direction=OUT, implementation-data-type=Std_ReturnType
      sw service arg user: direction=IN, implementation-data-type=EcuM_UserType  # ID of the entity requesting the POST RUN state.
    EcuM_RequestRUN: service-id=3, is-reentrant=true, is-synchronous=true, call-type=REGULAR  # Places a request for the RUN state. Requests can be placed by every user made known to the state manager at configuration time.
      return type Std_ReturnType: direction=OUT, implementation-data-type=Std_ReturnType
      sw service arg user: direction=IN, implementation-data-type=EcuM_UserType  # ID of the entity requesting the RUN state.
    EcuM_SelectBootTarget: service-id=18, is-reentrant=true, is-synchronous=true, call-type=REGULAR  # EcuM_SelectBootTarget selects a boot target. EcuM_SelectBootTarget is part of the ECU Manager Module port interface.
      return type Std_ReturnType: direction=OUT, implementation-data-type=Std_ReturnType
      sw service arg target: direction=IN, implementation-data-type=EcuM_BootTargetType  # The selected boot target.
    EcuM_SelectShutdownTarget: service-id=6, is-reentrant=true, is-synchronous=true, call-type=REGULAR  # EcuM_SelectShutdownTarget selects the shutdown target. EcuM_SelectShutdownTarget is part of the ECU Manager Module port interface.
      return type Std_ReturnType: direction=OUT, implementation-data-type=Std_ReturnType
      sw service arg target: direction=IN, implementation-data-type=EcuM_StateType  # The selected shutdown target.
      sw service arg mode: direction=IN, implementation-data-type=uint8  # The identfier of a sleep mode (if target is ECUM_STATE_SLEEP) or a reset mechanism (if target is ECUM_STATE_RESET) as defined by configuration.
    EcuM_Shutdown: service-id=2, is-reentrant=true, is-synchronous=true, call-type=REGULAR  # Typically called from the shutdown hook, this function takes over execution control and will carry out GO OFF II activities.
    EcuM_StartupTwo: service-id=26, is-reentrant=false, is-synchronous=true, call-type=REGULAR  # This function implements the STARTUP II state.
package /AUTOSAR_EcuM/ImplementationDataTypes
  16 x impl type:
    EcuM_WakeupSourceType: implementation-data-type=uint32
    EcuM_WakeupReactionType: implementation-data-type=uint8
    EcuM_WakeupStatusType: implementation-data-type=uint8
    EcuM_BootTargetType: compu {0=ECUM_BOOT_TARGET_APP, 1=ECUM_BOOT_TARGET_OEM_BOOTLOADER, 2=ECUM_BOOT_TARGET_SYS_BOOTLOADER}, range raw 0..2, implementation-data-type=uint8
    EcuM_SleepModeType: implementation-data-type=uint8
    EcuM_StateType:
      compu {15=ECUM_SUBSTATE_MASK, 16=ECUM_STATE_STARTUP, 17=ECUM_STATE_STARTUP_ONE, 18=ECUM_STATE_STARTUP_TWO, 32=ECUM_STATE_WAKEUP, 33=ECUM_STATE_WAKEUP_ONE, 34=ECUM_STATE_WAKEUP_VALIDATION, 35=ECUM_STATE_WAKEUP_REACTION, 36=ECUM_STATE_WAKEUP_TWO, 37=ECUM_STATE_WAKEUP_WAKESLEEP, 38=ECUM_STATE_WAKEUP_TTII, 48=ECUM_STATE_RUN, 50=ECUM_STATE_APP_RUN, 51=ECUM_STATE_APP_POST_RUN, 64=ECUM_STATE_SHUTDOWN, 68=ECUM_STATE_PREP_SHUTDOWN, 73=ECUM_STATE_GO_SLEEP, 77=ECUM_STATE_GO_OFF_ONE, 78=ECUM_STATE_GO_OFF_TWO, 80=ECUM_STATE_SLEEP, 128=ECUM_STATE_OFF, 144=ECUM_STATE_RESET}
      range raw 15..144
      implementation-data-type=uint8
    EcuM_UserType: implementation-data-type=uint8
    EcuM_AppModeType: implementation-data-type=uint8, type-emitter=EcuM
    EcuM_TimeoutType: implementation-data-type=uint16, type-emitter=EcuM
    EcuM_SleepModeConfig: category=STRUCTURE, type-emitter=EcuM
      element WakeupSourceMask: implementation-data-type=uint8
      element McuMode: implementation-data-type=uint8
      element McuSuspended: implementation-data-type=boolean
    EcuM_CommonWakeupSourceConfig: category=STRUCTURE, type-emitter=EcuM
      element ConfigType: implementation-data-type=uint8
      element Index: implementation-data-type=uint8
    EcuM_WakeupSourceConfig: category=STRUCTURE, type-emitter=EcuM
      6 x element, all with category=TYPE_REFERENCE:
        CheckWakeupTimeout: implementation-data-type=uint16
        ValidationTimeout: implementation-data-type=uint16
        RequiresPolling: implementation-data-type=boolean
        ComMChannel: implementation-data-type=uint8
        NumConfigs: implementation-data-type=uint8
        Configs: implementation-data-type=uint8
    EcuM_InitListEntryType: category=STRUCTURE, type-emitter=EcuM
      4 x element, all with category=TYPE_REFERENCE:
        InitFuncVoid: implementation-data-type=ConstVoidPtr
        InitFuncParam: implementation-data-type=ConstVoidPtr
        InitParam: implementation-data-type=ConstVoidPtr
        ParamType: implementation-data-type=uint8
    EcuM_InitListType: category=STRUCTURE, type-emitter=EcuM
      element Entries: implementation-data-type=ConstVoidPtr
      element NumEntries: implementation-data-type=uint8
    EcuM_ComMType: category=STRUCTURE, type-emitter=EcuM
      element CommunicationAllowedEntries: implementation-data-type=ConstVoidPtr
      element NumEntries: implementation-data-type=uint8
    EcuM_ConfigType: category=STRUCTURE
      23 x element, all with category=TYPE_REFERENCE, implementation-data-type=uint8:
        DriverInitListOne
        DriverInitListTwo
        DriverInitListThree
        RestartList
        DefaultAppMode
        RunMinimumDuration
        ComMData
        SleepModes
        WakeupSources
        GptWakeupSources
        IcuWakeupSources
        CanWakeupSources
        FrWakeupSources
        DefaultSleepMode
        NumSleepModes
        NumWakeupSources
        NormalMcuMode
        NvM_ReadAllTimeout
        NvM_WriteAllTimeout
        TTII_WakeupSourceMask
        DefaultShutdownTarget
        DefaultResetMode
        TTII_Enabled
package /AUTOSAR_EcuM/SwcBswMappings
  swc bsw mapping SBM_EcuM: bsw-behavior=IB_EcuM, swc-bsw-runnable-mapping{bsw-entity=EcuM_MainFunction, swc-runnable=EcuM_MainFunction}, swc-behavior=IB_EcuM
package /AUTOSAR_EcuM/SwcImplementations
  swc implementation Impl_EcuM: programming-language=C, swc-bsw-mapping=SBM_EcuM, behavior=IB_EcuM
package /AUTOSAR_EcuM/SwComponentTypes
  service sw component type EcuM
    behavior IB_EcuM: data-type-mapping=EcuM_DataTypeMappingSet, handle-termination-and-restart=NO-SUPPORT, included-data-type-set=data-type=[EcuM_StateType, EcuM_UserType, EcuM_BootTargetType, EcuM_AppModeType]
      runnable EcuM_MainFunction
package /AUTOSAR_EcuM/ClientServerInterfaces
  client server interface EcuM_BootTarget: is-service=true, service-kind=ECU-MANAGER
    operation SelectBootTarget: possible-error=[EcuM_BootTarget/E_OK, EcuM_BootTarget/E_NOT_OK]
      arg target: type=EcuM_BootTargetType, direction=IN
    operation GetBootTarget: possible-error=EcuM_BootTarget/E_OK
      arg target: type=EcuM_BootTargetType, direction=OUT
    error E_OK: error-code=0
    error E_NOT_OK: error-code=1
  client server interface EcuM_ShutdownTarget: is-service=true, service-kind=ECU-MANAGER
    operation SelectShutdownTarget: possible-error=[EcuM_ShutdownTarget/E_OK, EcuM_ShutdownTarget/E_NOT_OK]
      arg target: type=EcuM_StateType, direction=IN
      arg mode: type=uint8, direction=IN
    operation GetShutdownTarget: possible-error=EcuM_ShutdownTarget/E_OK
      arg target: type=EcuM_StateType, direction=OUT
      arg mode: type=uint8, direction=OUT
    operation GetLastShutdownTarget: possible-error=EcuM_ShutdownTarget/E_OK
      arg target: type=EcuM_StateType, direction=OUT
      arg mode: type=uint8, direction=OUT
    error E_OK: error-code=0
    error E_NOT_OK: error-code=1
  client server interface EcuM_StateRequest: is-service=true, service-kind=ECU-MANAGER
    4 x operation, all with possible-error=[EcuM_StateRequest/E_OK, EcuM_StateRequest/E_NOT_OK]:
      RequestRUN
      ReleaseRUN
      RequestPOSTRUN
      ReleasePOSTRUN
    error E_OK: error-code=0
    error E_NOT_OK: error-code=1
package /AUTOSAR_EcuM/DataTypeMappingSets
  data type mapping set EcuM_DataTypeMappingSet: mode-request-type-map{implementation-data-type=uint8, mode-group=EcuM_Mode}
package /AUTOSAR_EcuM/ModeDeclarationGroups
  mode declaration group EcuM_Mode: category=ALPHABETIC_ORDER, initial-mode=STARTUP
    6 x mode:
      STARTUP
      RUN
      POST_RUN
      SLEEP
      WAKE_SLEEP
      SHUTDOWN
package /AUTOSAR_EcuM/ModeSwitchInterfaces
  mode switch interface EcuM_CurrentMode: is-service=true, service-kind=ECU-MANAGER
    mode group currentMode: type=EcuM_Mode
